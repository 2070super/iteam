#include "Config.h"
#include "Target.h"
#define  BEEP  (1<<7)
/****************************************************************************
* 名称：DelayNS()
* 功能：长软件延时
* 入口参数：dly		延时参数，值越大，延时越久
* 出口参数：无
****************************************************************************/
void  DelayNS(uint32  dly)
{
   uint32  i;

   for(; dly>0; dly--)

      for(i=0; i<3000; i++);
}
/*
*********************************************************************************************************
** 函数名称 ：main()
** 函数功能 ：演示外部中断唤醒掉电的CPU，但不产生中断
** 入口参数 ：无
** 出口参数 ：无
*********************************************************************************************************
*/
int  main(void)
{  PINSEL0 = 0x00000000;		 // 设置所有管脚连接GPIO*/
   PINSEL1 = 0x00000300;                // 设置管脚连接，P0.20设置为EINT3
   IO0DIR  = BEEP;
    /* 打开EINT0中断(使用非向量IRQ) */
	EXTWAKE = 0x08;					// 外部中断3唤醒芯片
	EXTINT  = 0x08;					// 清除EINT3中断标志	
	IO0CLR = BEEP;
	while (1)	
	{      
		PCONP = 0x00;					// 关闭定时器、RTC、UART等功能部件
		PCON  = 0x02;					// 系统进入掉电模式	
		/* 当系统被唤醒后，取反BEEP控制 */
                 if((IO0SET&BEEP)==0)
		  IO0SET = BEEP;
                 else
                  IO0CLR = BEEP;
                  while((EXTINT&0X08)!=0)
                  EXTINT=0X08;
	}

 
}

